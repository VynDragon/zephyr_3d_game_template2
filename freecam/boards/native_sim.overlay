#include <zephyr/dt-bindings/input/input-event-codes.h>

&sdl_dc {
	compatible = "zephyr,sdl-dc";
	height = <512>;
	width = <1024>;
	pixel-format = <PANEL_PIXEL_FORMAT_L_8>;
};

/ {
	soc {
		evdev {
			compatible = "zephyr,native-linux-evdev";
		};
	};
};
