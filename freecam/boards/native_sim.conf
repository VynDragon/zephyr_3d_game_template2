## freecam/boards/native_sim.conf
```kconfig
CONFIG_SDL_DISPLAY_DEFAULT_PIXEL_FORMAT_L_8=y
CONFIG_SDL_DISPLAY_ZOOM_PCT=250
#CONFIG_SDL_DISPLAY_ZOOM_PCT=400
#CONFIG_SDL_DISPLAY_DEFAULT_PIXEL_FORMAT_RGB_565=y
CONFIG_RESOLUTION_X=1024
CONFIG_RESOLUTION_Y=512
CONFIG_TARGET_PROCESS_FPS=30
CONFIG_TARGET_RENDER_FPS=30
CONFIG_SYS_CLOCK_TICKS_PER_SEC=10000
CONFIG_LV_COLOR_DEPTH_8=y
CONFIG_HEAP_MEM_POOL_SIZE=65536
CONFIG_MAIN_STACK_SIZE=65536
CONFIG_LV_Z_MEM_POOL_SIZE=131072
```

## freecam/boards/rpi_pico.conf
```kconfig
CONFIG_TARGET_PROCESS_FPS=30
CONFIG_TARGET_RENDER_FPS=4
CONFIG_RESOLUTION_X=240
CONFIG_RESOLUTION_Y=128
CONFIG_SSD1322_DEFAULT_GRAYSCALE=y
```

## lib/Kconfig
```kconfig
config L3
	bool "Enable L3 Library"
	default n

config ENGINE
	bool "Enable Engine"
	default n
	select L3

config HEADLESS
	bool "Headless Mode"
	default n

config RENDER_THREAD_STACK
	int "size of render thread's stack size"
	default 4096

config PROCESS_THREAD_STACK
	int "size of processing thread's stack size"
	default 2048

config BLIT_THREAD_STACK
	int "size of blitting thread's stack size"
	default 2048

config BLIT_THREAD
	bool "Blit in separate thread"
	default y
```
